## config/boards/shields/glidepoint_test/Kconfig.defconfig
```kconfig
if SHIELD_GLIDEPOINT_TEST

config ZMK_KEYBOARD_NAME
    default "Glidepoint Test"

config ZMK_POINTING
    default y

config I2C
    default y

endif
```

## config/boards/shields/glidepoint_test/Kconfig.shield
```kconfig
config SHIELD_GLIDEPOINT_TEST
    def_bool $(shields_list_contains,glidepoint_test)
```
